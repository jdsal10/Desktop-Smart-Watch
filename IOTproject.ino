/*************************************************************
  Blynk is a platform with iOS and Android apps to control
  ESP32, Arduino, Raspberry Pi and the likes over the Internet.
  You can easily build mobile and web interfaces for any
  projects by simply dragging and dropping widgets.

    Downloads, docs, tutorials: https://www.blynk.io
    Sketch generator:           https://examples.blynk.cc
    Blynk community:            https://community.blynk.cc
    Follow us:                  https://www.fb.com/blynkapp
                                https://twitter.com/blynk_app

  Blynk library is licensed under MIT license
 *************************************************************
  Blynk.Edgent implements:
  - Blynk.Inject - Dynamic WiFi credentials provisioning
  - Blynk.Air    - Over The Air firmware updates
  - Device state indication using a physical LED
  - Credentials reset using a physical Button
 *************************************************************/

/* Fill in information from your Blynk Template here */
/* Read more: https://bit.ly/BlynkInject */
//#define BLYNK_TEMPLATE_ID           "TMPxxxxxx"
//#define BLYNK_TEMPLATE_NAME         "Device"
#define BLYNK_TEMPLATE_ID "TMPL5Lem6opHn"
#define BLYNK_TEMPLATE_NAME "Device"

#define BLYNK_FIRMWARE_VERSION "0.1.0"

#define BLYNK_PRINT Serial
//#define BLYNK_DEBUG

#define APP_DEBUG

// Uncomment your board, or configure a custom board in Settings.h
//#define USE_ESP32_DEV_MODULE
//#define USE_ESP32C3_DEV_MODULE
//#define USE_ESP32S2_DEV_KIT
//#define USE_WROVER_BOARD
//#define USE_TTGO_T7
//#define USE_TTGO_T_OI

#include "BlynkEdgent.h"

//Libraries for the watch and sensor
#include <SPI.h>
#include <Wire.h>
#include <Adafruit_GFX.h>
#include <Adafruit_SSD1306.h>

#include <Arduino.h>
#ifdef ESP32
#include <WiFi.h>
#else
#include <ESP8266WiFi.h>
#endif
#include <time.h>

//Screen settings
#define SCREEN_WIDTH 128
#define SCREEN_HEIGHT 64

#define OLED_MOSI 23
#define OLED_CLK 18
#define OLED_DC 16
#define OLED_CS 5
#define OLED_RESET 17

//Connection for screen
Adafruit_SSD1306 display(SCREEN_WIDTH, SCREEN_HEIGHT,
                         OLED_MOSI, OLED_CLK, OLED_DC, OLED_RESET, OLED_CS);

//Wi-Fi Credentials

const char* ssid = "NOWF96GS";
const char* password = "9HUE55KGxxmr";

int GMTOffset = 0;       //Replace with your GMT Offset in seconds
int daylightOffset = 0;  //Replace with your daylight savings offset in

const unsigned char electronicshub_logo[] PROGMEM = {
  0x00, 0x00, 0x00, 0x00, 0x00, 0x00, 0x00, 0x00, 0x00, 0x00, 0x00, 0x00, 0x00, 0x00, 0x00, 0x00,
  0x00, 0x00, 0x00, 0x00, 0x00, 0x00, 0x00, 0x00, 0x00, 0x00, 0x00, 0x00, 0x00, 0x00, 0x00, 0x00,
  0x00, 0x00, 0x00, 0x00, 0x00, 0x00, 0x00, 0x00, 0x00, 0x00, 0x00, 0x00, 0x00, 0x00, 0x00, 0x00,
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  0x00, 0x00, 0x00, 0x00, 0x00, 0x00, 0x00, 0x00, 0x00, 0x00, 0x00, 0x00, 0x00, 0x00, 0x00, 0x00
};


//Seonsor varibales
const int PIR_SENSOR_OUTPUT_PIN = 13; /* PIR sensor O/P pin */
int warm_up;


//filter window size
const int filterWindow = 10;
float filterBuffer[filterWindow]{ 0 };

unsigned long seconds;
unsigned long minutes;
unsigned long hours;


//New Timer
bool TimerStarted = false;
unsigned long startTime = 0;
unsigned long durationTime = 0;


//To read pin from Blynk. Set virtual pin
BLYNK_WRITE(V0) {
  int pinValue = param.asInt();
  //Sending data to pin 14 of the esp32 board
  digitalWrite(14, pinValue);
}

void setup() {
  //Blynk code
  pinMode(PIR_SENSOR_OUTPUT_PIN, INPUT);
  Serial.begin(115200); /* Define baud rate for serial communication */
  Serial.println("Waiting For Power On Warm Up");
  Serial.println("Ready!");

  //Connect to Wifi
  WiFi.begin(ssid, password);
  while (WiFi.status() != WL_CONNECTED) {
    delay(1000);
    Serial.println("Connecting...");
  }

  Serial.println("Connected to Wi-Fi!");

  if (!display.begin(SSD1306_SWITCHCAPVCC)) {
    Serial.println(F("SSD1306 allocation failed"));
    for (;;)
      ;
  }

  //clear led screen
  display.clearDisplay();
  display.display();

  configTime(GMTOffset, daylightOffset, "pool.ntp.org", "time.nist.gov");

  //Blybk output pin
  pinMode(14, OUTPUT);

  BlynkEdgent.begin();
}

void loop() {
  BlynkEdgent.run();

  // Check the state of pin 14 and print to the terminal
  int pinState = digitalRead(14);
  if (pinState == HIGH) {
    Serial.println("Pin 14 is HIGH");
  } else {
    Serial.println("Pin 14 is LOW");
  }


  int sensor_output;
  sensor_output = digitalRead(PIR_SENSOR_OUTPUT_PIN);

  //Update buffer filterBuffer
  filterBuffer[filterWindow - 1] = sensor_output;
  Serial.println(sensor_output);
  Serial.println();
  for (int i = 0; i < filterWindow - 1; i++) {
    filterBuffer[i] = filterBuffer[i + 1];
  }

  //Calculating moving average
  float filteredOutput = 0;
  for (int i = 0; i < filterWindow; i++) {
    filteredOutput += filterBuffer[i];
  }
  filteredOutput /= filterWindow;

  // Print individual elements of filterBuffer
  for (int i = 0; i < filterWindow; i++) {
    Serial.print(filterBuffer[i]);
    Serial.print(" ");
  }
  Serial.println();  // Move to the next line after printing all elements

  //check if there has been human presence
  bool presence = false;
  for (int i = 0; i < filterWindow; i++) {
    if (filterBuffer[i] == 1) {
      presence = true;
    }
  }

  //if no human presence warm up sensor
  if (sensor_output == LOW) {
    if (warm_up == 1) {
      Serial.print("Warming Up\n\n");
      warm_up = 0;
      delay(2000);
    }

    Serial.print("No object in sight\n\n");
    if (filteredOutput < 0.2 && presence) {
      Serial.print(filteredOutput);
      Serial.print(" ");
      Serial.print("Detection Stopped\n\n");
      display.clearDisplay();
      display.display();

      //should reset timer
      startTime = 0;
      seconds = 0;
      minutes = 0;
      hours = 0;
      updateTimer();

    }
    delay(1000);

  } else {

    //New Timer
    Serial.print("Person detected\n\n");

    if(startTime == 0){
      startTime = millis();
    }

    durationTime = millis() - startTime;

    seconds = durationTime/1000;
    
    minutes = seconds / 60;

    hours = minutes / 60;

     //check that the values for seconds, minutes and hours are correct
    if(seconds >= 60){
      seconds %= 60; // Reset seconds to 0 and keep the remainder
    }
    if(minutes >= 60){
      minutes %= 60; // Reset minutes to 0 and keep the remainder
    }
    if(hours >= 24){
      hours = 0;
    }


    updateTimer();

    // Timer();

    if(pinState == HIGH){
      Analog();
      warm_up = 1;
      delay(1000);
    }else if(pinState == LOW){
      Digital();
      warm_up = 1;
      delay(1000);
      //method to start timer
    }
    
  }

  delay(1000);  // Add a delay to avoid continuous prints
}

void updateTimer()
{
  String timer = String(hours) + " : " + String(minutes) + " : " + String(seconds);
  Blynk.virtualWrite(V1, timer);
}

void NewTimer()
{

}

void Timer()
{
  seconds++;

  if (seconds >= 60) {
    seconds = 0;
    minutes++;

    if (minutes >= 60) {
      minutes = 0;
      hours++;

      if (hours >= 24) {
        hours = 0;
      }
    }
  }

  //Update timer on the application
  updateTimer();
}


void Analog() {
  time_t rawtime = time(nullptr);
  struct tm* timeinfo = localtime(&rawtime);
  display.clearDisplay();
  display.setTextSize(1);
  int circleX = SCREEN_WIDTH / 2;
  int circleY = SCREEN_HEIGHT / 2;
  int radius = 29;
  display.drawCircle(circleX, circleY, radius, SSD1306_WHITE);

  for (int i = 0; i < 360; i = i + 30) {
    float angle = i;
    angle = (angle / 57.29577951);
    int x1 = (64 + (sin(angle) * radius));
    int y1 = (32 - (cos(angle) * radius));
    int x2 = (64 + (sin(angle) * (radius - 5)));
    int y2 = (32 - (cos(angle) * (radius - 5)));
    display.drawLine(x1, y1, x2, y2, WHITE);
  }

  //draw second hand
  float angle = timeinfo->tm_sec * 6;
  angle = (angle / 57.29577951);
  int x2 = (64 + (sin(angle) * (radius)));
  int y2 = (32 - (cos(angle) * (radius)));
  display.drawLine(64, 32, x2, y2, WHITE);

  // draw minute hand
  angle = timeinfo->tm_min * 6;
  angle = (angle / 57.29577951);
  x2 = (64 + (sin(angle) * (radius - 3)));
  y2 = (32 - (cos(angle) * (radius - 3)));
  display.drawLine(64, 32, x2, y2, WHITE);

  // draw hour hand
  angle = timeinfo->tm_hour * 30 + int((timeinfo->tm_min / 12) * 6);
  angle = (angle / 57.29577951);
  x2 = (64 + (sin(angle) * (radius - 11)));
  y2 = (32 - (cos(angle) * (radius - 11)));
  display.drawLine(64, 32, x2, y2, WHITE);

  display.display();
  delay(2000);
}



void Digital() {
  time_t rawtime = time(nullptr);
  struct tm* timeinfo = localtime(&rawtime);

  Serial.print("Time: ");
  Serial.print(timeinfo->tm_hour);
  Serial.print(":");
  Serial.print(timeinfo->tm_min);
  Serial.print(":");
  Serial.println(timeinfo->tm_sec);

  display.clearDisplay();
  display.setTextSize(3);
  display.setTextColor(WHITE);
  display.setCursor(0, 25);
  display.print(timeinfo->tm_hour);
  display.print(":");
  if (timeinfo->tm_min < 10)
  display.print("0");
  display.print(timeinfo->tm_min);

  display.setTextSize(2);
  display.setCursor(90, 30);
  display.print(":");
  if (timeinfo->tm_sec < 10)
  display.print("0");
  display.print(timeinfo->tm_sec);
  display.display();

  delay(1000);
}
